## esp32p4/main/Kconfig.projbuild
```kconfig
menu "P4 USB 카메라 WebRTC"

    menu "WiFi"
        config APP_WIFI_SSID
            string "공유기 이름(SSID)"
            default "myssid"

        config APP_WIFI_PASSWORD
            string "공유기 비밀번호"
            default "mypassword"

        config APP_MDNS_HOSTNAME
            string "mDNS 이름 (http://<이름>.local)"
            default "p4cam"
    endmenu

    menu "카메라 / 영상"
        config APP_STREAM_WIDTH
            int "실시간 영상 가로 해상도"
            range 160 1920
            default 1280
            help
                카메라가 MJPEG 로 내보내는 해상도 중에서 고릅니다.
                IMX298(B0290) 은 1920x1080, 1280x720 을 30fps 로 낼 수 있습니다.
                하드웨어 H.264 인코더 한계가 가로 1920 입니다.

        config APP_STREAM_HEIGHT
            int "실시간 영상 세로 해상도"
            range 120 1088
            default 720

        config APP_STREAM_FPS
            int "실시간 영상 프레임레이트"
            range 5 30
            default 30

        config APP_H264_BITRATE_KBPS
            int "H.264 최대 비트레이트 (kbps)"
            range 300 10000
            default 2000
            help
                연결 직후 이 값으로 시작하고, 브라우저가 알려 주는 손실률·대역폭(TWCC/REMB)에 따라
                아래 최소값까지 자동으로 내렸다가 다시 올립니다.

        config APP_H264_MIN_BITRATE_KBPS
            int "H.264 최소 비트레이트 (kbps)"
            range 200 10000
            default 500

        config APP_H264_GOP
            int "키프레임 간격 (프레임 수)"
            range 1 255
            default 60
            help
                키프레임은 P 프레임보다 5~10배 커서 WiFi 로 한꺼번에 보낼 때 유실이 잘 납니다.
                너무 자주 넣지 않는 편이 덜 끊깁니다. 패킷이 유실되면 브라우저가 키프레임을
                요청(PLI)하고 그때 바로 보내므로 이 간격과 상관없이 복구됩니다.

        config APP_UVC_CONSTANT_FPS
            bool "카메라 프레임레이트 고정 (어두워도 fps 유지)"
            default y
            help
                UVC 카메라는 어두우면 노출 시간을 늘리려고 스스로 7.5~15fps 로 떨어집니다
                (Auto-Exposure Priority). 켜면 화면이 조금 어두워지는 대신 설정한 fps 를 유지합니다.

        config APP_UVC_FRAME_BUF_KB
            int "USB 프레임 버퍼 1개 크기 (KB)"
            range 512 16384
            default 4096
            help
                고해상도 스냅샷(16MP MJPEG) 한 장이 들어갈 만큼 커야 합니다.
                버퍼가 작으면 고해상도 스냅샷이 실패하고 실시간 해상도로 대신 찍힙니다.
                PSRAM 이 16MB 인 보드라면 2048~3072 정도로 줄이세요.

        config APP_UVC_FRAME_BUF_COUNT
            int "USB 프레임 버퍼 개수"
            range 2 4
            default 3

        config APP_SNAPSHOT_SKIP_FRAMES
            int "고해상도 전환 후 버릴 프레임 수"
            range 0 10
            default 2
            help
                해상도를 바꾼 직후 몇 장은 노출이 덜 잡혀 어둡거나 깨질 수 있어 버립니다.
    endmenu

    menu "WebRTC"
        config APP_STUN_URL
            string "STUN 서버 (같은 공유기 안에서만 쓰면 비워 두세요)"
            default ""
            help
                예: stun:stun.l.google.com:19302
                비워 두면 같은 네트워크(공유기) 안에서 바로 연결합니다.
    endmenu

endmenu
```
